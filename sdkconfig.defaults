## sdkconfig.defaults
```kconfig
# Milestone 1 dual-framework defaults for ESP-IDF 4.4 + Arduino-as-component.
# These keep the app close to current behavior while exposing coexistence
# and memory tuning through repo-controlled configuration.

CONFIG_ESPTOOLPY_FLASHSIZE_4MB=y
# CONFIG_ESPTOOLPY_FLASHSIZE_2MB is not set
CONFIG_ESPTOOLPY_FLASHSIZE="4MB"
# CONFIG_ESPTOOLPY_FLASHSIZE_DETECT is not set

# Use the repo-managed huge-app partition map in both Arduino and ESP-IDF.
CONFIG_PARTITION_TABLE_CUSTOM=y
# CONFIG_PARTITION_TABLE_SINGLE_APP is not set
CONFIG_PARTITION_TABLE_CUSTOM_FILENAME="huge_app.csv"
CONFIG_PARTITION_TABLE_FILENAME="huge_app.csv"
CONFIG_ARDUHAL_PARTITION_SCHEME_HUGE_APP=y
# CONFIG_ARDUHAL_PARTITION_SCHEME_DEFAULT is not set
CONFIG_ARDUHAL_PARTITION_SCHEME="huge_app"
CONFIG_AUTOSTART_ARDUINO=y

CONFIG_FREERTOS_HZ=1000
CONFIG_BT_ENABLED=y
CONFIG_BT_BLUEDROID_ENABLED=y
CONFIG_BTDM_CTRL_MODE_BR_EDR_ONLY=y
CONFIG_BTDM_CTRL_HCI_MODE_VHCI=y
CONFIG_BT_CLASSIC_ENABLED=y
CONFIG_BT_A2DP_ENABLE=y
CONFIG_BT_SPP_ENABLED=y
CONFIG_HTTPD_WS_SUPPORT=y

# Use software coexistence and keep BT/WiFi work on separate cores.
CONFIG_ESP32_WIFI_SW_COEXIST_ENABLE=y
CONFIG_BTDM_CTRL_PINNED_TO_CORE_0=y
CONFIG_BT_BLUEDROID_PINNED_TO_CORE_0=y
CONFIG_ESP32_WIFI_TASK_PINNED_TO_CORE_1=y
# CONFIG_ESP32_WIFI_TASK_PINNED_TO_CORE_0 is not set

# Start with conservative WiFi buffer counts to lower RAM pressure on ESP32.
CONFIG_ESP32_WIFI_STATIC_RX_BUFFER_NUM=8
CONFIG_ESP32_WIFI_DYNAMIC_RX_BUFFER_NUM=16
CONFIG_ESP32_WIFI_DYNAMIC_TX_BUFFER=y
CONFIG_ESP32_WIFI_DYNAMIC_TX_BUFFER_NUM=16
CONFIG_ESP32_WIFI_TX_BA_WIN=8
```
